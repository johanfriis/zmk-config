#define ZMK_MOUSE_DEFAULT_MOVE_VAL 1500  // 600
#define ZMK_MOUSE_DEFAULT_SCRL_VAL 20    // 10

#include <dt-bindings/zmk/mouse.h>

// Config from @caksoylar, defaults in comments
&mmv {
  acceleration-exponent = <1>;      // 1
  time-to-max-speed-ms = <500>;     // 300
  delay-ms = <0>;                   // 0
};

&msc {
  acceleration-exponent = <1>;      // 0
  time-to-max-speed-ms = <40>;      // 300
  delay-ms = <0>;                   // 0
};

#define U_MS_U &mmv MOVE_UP
#define U_MS_D &mmv MOVE_DOWN
#define U_MS_L &mmv MOVE_LEFT
#define U_MS_R &mmv MOVE_RIGHT
#define U_WH_U &msc SCRL_UP
#define U_WH_D &msc SCRL_DOWN
#define U_WH_L &msc SCRL_LEFT
#define U_WH_R &msc SCRL_RIGHT


// #define m_BUTTN_1_m &mkp MB1
// #define m_BUTTN_2_m &mkp MB2
// #define m_BUTTN_3_m &mkp MB3

// #define m_MOUSE_U_m &mmv MOVE_Y(-U_MOUSE_MOVE_MAX)
// #define m_MOUSE_D_m &mmv MOVE_Y(U_MOUSE_MOVE_MAX)
// #define m_MOUSE_L_m &mmv MOVE_X(-U_MOUSE_MOVE_MAX)
// #define m_MOUSE_R_m &mmv MOVE_X(U_MOUSE_MOVE_MAX)

// #define m_SCROL_U_m &msc SCRL_Y(-U_MOUSE_SCROLL_MAX) /* */
// #define m_SCROL_D_m &msc SCRL_Y(U_MOUSE_SCROLL_MAX)
// #define m_SCROL_L_m &msc SCRL_X(-U_MOUSE_SCROLL_MAX)
// #define m_SCROL_R_m &msc SCRL_X(U_MOUSE_SCROLL_MAX)
