#include <behaviors.dtsi>
#include <behaviors/num_word.dtsi> // requires auto-layer module
#include <dt-bindings/zmk/keys.h>

#ifdef CONFIG_WIRELESS
    #include <dt-bindings/zmk/bt.h>
    #define _BT_SEL_KEYS_ &bt BT_SEL 0 &bt BT_SEL 1 &bt BT_SEL 2 &bt BT_SEL 3 &bt BT_CLR
#else
    #define _BT_SEL_KEYS_ &trans &trans &trans &trans &trans
#endif

#include "zmk-helpers/helper.h"
#include "zmk-helpers/unicode-chars/danish.dtsi"
#include "keycodes.h"

#define DEF 0
#define NAV 1
#define SYM 2
#define NUM 3
#define SYS 4
#define MOUSE 5

#define XXX &none
#define ___ &trans

/*****************************************************************************
    Global settings
 *****************************************************************************/

#define QUICK_TAP_MS 175

&sk {  // sticky-key config
    release-after-ms = <900>;  // release after 0.9s
    quick-release;             // no double capitalization when rolling keys
};

&sl {  // sticky-layer config
    ignore-modifiers;          // allow chording sticky mods & layers
};

&lt {  // layer-tap config
    flavor = "balanced";
    tapping-term-ms = <200>;
    quick-tap-ms = <QUICK_TAP_MS>;
};

&leader {  // leader-key config
    timeout-ms = <650>;
};


/*****************************************************************************
    Hold tap helpers
 *****************************************************************************/

#define MAKE_HOLD_TAP(NAME, HOLD, TAP, TRIGGER_POS) \
    ZMK_HOLD_TAP(NAME, \
        flavor = "balanced"; \
        tapping-term-ms = <280>; \
        quick-tap-ms = <QUICK_TAP_MS>; \
        require-prior-idle-ms = <150>; \
        bindings = <HOLD>, <TAP>; \
        hold-trigger-key-positions = <TRIGGER_POS>; \
        hold-trigger-on-release; \
    )

MAKE_HOLD_TAP(lhm, &kp, &kp, KEYS_R THUMBS)  // left-hand HRMs
MAKE_HOLD_TAP(rhm, &kp, &kp, KEYS_L THUMBS)  // right-hand HRMs

MAKE_HOLD_TAP(thumb_alpha, &mo, &kp, KEYS_L KEYS_R THUMBS)  // thumb-alpha layer taps

MAKE_HOLD_TAP(linger, &kp, &kp, KEYS_L KEYS_R THUMBS)  // linger key

// HRM combo hack - workaround for lack of tap-only combos (ZMK issue #544)
#define ZMK_COMBO_8(NAME, TAP, KEYPOS, LAYERS, COMBO_TERM, COMBO_IDLE, HOLD, SIDE) \
    MAKE_HOLD_TAP(hm_combo_ ## NAME, &kp, TAP, SIDE THUMBS) \
    ZMK_COMBO_6(NAME, &hm_combo_ ## NAME HOLD 0, KEYPOS, LAYERS, COMBO_TERM, COMBO_IDLE)


/*****************************************************************************
    Combos, leader key sequences, mouse emulation
 *****************************************************************************/

#include "combos.dtsi"  // must be sourced after HRM-combo hack
#include "leader.dtsi"
#include "mouse.dtsi"


/*****************************************************************************
    Homerow mods
 *****************************************************************************/

#define __LCTL___ &lhm LCTL
#define __LOPT___ &lhm LOPT
#define __LGUI___ &lhm LGUI
#define __LSFT___ &lhm LSFT
#define __RSFT___ &rhm RSFT
#define __RGUI___ &rhm RGUI
#define __ROPT___ &rhm RALT
#define __RCTL___ &rhm RCTL


/*****************************************************************************
    Caps-word, num-word and smart-mouse
 *****************************************************************************/

// tap: sticky-shift | shift + tap/ double-tap: caps-word | hold: shift
ZMK_MOD_MORPH(smart_shft,
    bindings = <&sk LSHFT>, <&caps_word>;
    mods = <(MOD_LSFT)>;
)
&caps_word {  // mods deactivate caps-word, requires PR #1451
    /delete-property/ ignore-modifiers;
};

#define _SMRT_SHFT_ &smart_shft

// tap: num-word | double-tap: sticky num-layer | hold: num-layer
ZMK_HOLD_TAP(smart_num,
    flavor = "balanced";
    tapping-term-ms = <200>;
    quick-tap-ms = <QUICK_TAP_MS>;
    bindings = <&mo>, <&num_dance>;
)
ZMK_TAP_DANCE(num_dance,
    tapping-term-ms = <200>;
    bindings = <&num_word NUM>, <&sl NUM>;  // reverse this for sticky-num on single tap
)
#define _SMRT__NUM_ &smart_num NUM 0

#ifndef MOUSE_IGNORED_KEYS
    #define MOUSE_IGNORED_KEYS LT1 LT3 RT0 RT1 RT2 RT3 RT4 RM1 RM2 RM3 RB1 RB2 RB3 RH0 RH1
#endif

// smart-mouse, requires PR #1366
ZMK_TRI_STATE(smart_mouse,
    bindings = <&tog MOUSE>, <&none>, <&tog MOUSE>;
    ignored-key-positions = <MOUSE_IGNORED_KEYS>;
    ignored-layers = <MOUSE>;
)

/*****************************************************************************
    Swappers, requires PR #1366
 *****************************************************************************/

#ifndef REVERSE_SWAPPER
    #define REVERSE_SWAPPER LT1
#endif

// GUI+TAB
ZMK_TRI_STATE(app_swap,
    bindings = <&kt LGUI>, <&kp TAB>, <&kt LGUI>;
    ignored-key-positions = <REVERSE_SWAPPER>;
)

// GUI+` (GRAVE)
ZMK_TRI_STATE(win_swap,
    bindings = <&kt LGUI>, <&kp GRAVE>, <&kt LGUI>;
    ignored-key-positions = <REVERSE_SWAPPER>;
)

// CTL+TAB
ZMK_TRI_STATE(tab_swap,
    bindings = <&kt LCTL>, <&kp TAB>, <&kt LCTL>;
    ignored-key-positions = <REVERSE_SWAPPER>;
)

#define __APP_SWP__ &app_swap
#define __WIN_SWP__ &win_swap
#define __TAB_SWP__ &tab_swap


/*****************************************************************************
    Copy / Paste / Select / Undo 
 *****************************************************************************/

// tap: undo | double-tap: redo
ZMK_TAP_DANCE(undo_redo,
    tapping-term-ms = <200>;
    bindings = <&kp LG(Z)>, <&kp LG(LS(Z))>;
)

#define _UNDO_REDO_ &undo_redo 
#define __CPY_CUT__ &linger LG(X) LG(C)
#define _PSTE_SLCT_ &linger LG(A) LG(V)


/*****************************************************************************
    Symbol remapping
 *****************************************************************************/

// reuse basic mod-morph scheme
#define SIMPLE_MORPH(NAME, MOD, BINDING1, BINDING2) \
    ZMK_MOD_MORPH(NAME, \
        mods = <(MOD_L ## MOD|MOD_R ## MOD)>; \
        bindings = <BINDING1>, <BINDING2>; \
    )

// tap: . | shift + tap: : | opt + tap: !
SIMPLE_MORPH(__dot_mph, OPT, ____DOT____, ___EXCLM___)
SIMPLE_MORPH(dot_morph, SFT, &__dot_mph,  ___COLON___)
#define m___DOT___m &dot_morph

// tap: , | shift + tap: ; | opt + tap: ?
SIMPLE_MORPH(__comma_mph, OPT, ___COMMA___,  ___QUEST___)
SIMPLE_MORPH(comma_morph, SFT, &__comma_mph, _SEMICOLON_)
#define m__COMMA__m &comma_morph

// tap: - | opt + tap: |
SIMPLE_MORPH(minus_morph, OPT, ___MINUS___,  ____AMP____)
#define m__MINUS__m &minus_morph

// tap: / | shift + tap: \ | opt + tap: |
SIMPLE_MORPH(__slash_mph, OPT, ___SLASH___,  ___PIPE____)
SIMPLE_MORPH(slash_morph, SFT, &__slash_mph, _BACKSLASH_)
#define m__SLASH__m &slash_morph

// tap: = | opt + tap: ~
SIMPLE_MORPH(equal_morph, OPT, ___EQUAL___, ___TILDE___)
#define m__EQUAL__m &equal_morph

// tap: ' | opt + tap: %
SIMPLE_MORPH(squot_morph, OPT, ___SQUOT___, __PERCENT__ )
#define m__SQUOT__m &squot_morph

// tap: ` | shift + tap: ^ | opt + tap: !
SIMPLE_MORPH(__grave_mph, OPT, ___GRAVE___,     ___EXCLM___)
SIMPLE_MORPH(grave_morph, SFT, &__grave_mph, ___CARET___)
#define m__GRAVE__m &grave_morph

// tap: ( / ) | shift + tap: { / }
SIMPLE_MORPH(lparn_morph, SFT, ___LPARN___ , ___LBRCE___)
SIMPLE_MORPH(rparn_morph, SFT, ___RPARN___ , ___RBRCE___)
#define m__LPARN__m &lparn_morph
#define m__RPARN__m &rparn_morph

// tap: [ / ] | shift + tap: < / >
SIMPLE_MORPH(lbrck_morph, SFT, ___LBRCK___, ___LANGB___)
SIMPLE_MORPH(rbrck_morph, SFT, ___RBRCK___, ___RANGB___)
#define m__LBRCK__m &lbrck_morph
#define m__RBRCK__m &rbrck_morph

// tap: u | opt + tap: @
SIMPLE_MORPH(kp_u_mph, OPT, _____U_____, __ATSIGN___)
#define m____U____m &kp_u_mph

// tap: u | opt + tap: *
SIMPLE_MORPH(kp_o_mph, OPT, _____O_____, ___STAR____)
#define m____O____m &kp_o_mph

// tap: y | opt + tap: #
SIMPLE_MORPH(kp_y_mph, OPT, _____Y_____, ___HASH____)
#define m____Y____m &kp_y_mph

// tap: p | opt + tap: $
SIMPLE_MORPH(kp_p_mph, OPT, _____P_____, __DOLLAR___)
#define m____P____m &kp_p_mph


/*****************************************************************************
    Custom behaviors
 *****************************************************************************/

// tap: space | shift + tap: dot -> space -> sticky shift | hold: activate layer
ZMK_MACRO(dot_spc,
    wait-ms = <0>;
    tap-ms = <5>;
    bindings = <&kp DOT &kp SPACE &sk LSHFT>;
)
SIMPLE_MORPH(spc_morph, SFT, &kp SPACE, &dot_spc)
ZMK_HOLD_TAP(lt_spc,
    flavor = "balanced";
    tapping-term-ms = <200>;
    quick-tap-ms = <QUICK_TAP_MS>;
    bindings = <&mo>, <&spc_morph>;
)

// tap: backspace | lshft + tap: delete | rshft + tap: shift-delete
ZMK_MOD_MORPH(bs_del,
    bindings = <&kp BSPC>, <&kp DEL>;
    mods = <(MOD_LSFT|MOD_RSFT)>;
    keep-mods = <MOD_RSFT>;
)


// Sticky shift + leader
// ZMK_MACRO(leader_sft, bindings = <&sk LSHFT &leader>;)

// misc aliases
#define CANCEL      &kp K_CANCEL             // cancel caps-word, num-word and smart-mouse
// #define DSK_PREV    &hmr LCTRL LG(LC(LEFT))  // previous desktop
// #define DSK_NEXT    &hmr LALT LG(LC(RIGHT))  // next     desktop
// #define PIN_WIN     &kp LG(LC(LS(Q)))        // pin window across desktops
// #define PIN_APP     &kp LG(LC(LS(A)))        // pin application across desktops
// #define DSK_MGR     &kp LA(GRAVE)            // desktop manager
// #define VOL_DOWN    &hmr RSHFT C_VOL_DN

/* Keymap */

// ZMK_CONDITIONAL_LAYER(sys, FN NUM, SYS)  // FN + NUM --> SYS

// ZMK_LAYER(base,
// //╭──────╮ ╭─────────────┬─────────────┬─────────────┬─────────────┬─────────────╮ ╭──────╮ ╭─────────────┬─────────────┬─────────────┬─────────────┬─────────────╮ ╭──────╮
//     X_LT     &kp Q         &kp W         &kp F         &kp P         &kp B           X_MT     &kp J         &kp L         &kp U         &kp Y         &kp SQT         X_RT
// //├──────┤ ├─────────────┼─────────────┼─────────────┼─────────────┼─────────────┤ ├──────┤ ├─────────────┼─────────────┼─────────────┼─────────────┼─────────────┤ ├──────┤
//     X_LM     &hml LCTRL A  &hml LALT R   &hml LGUI S   &hml LSHFT T  &kp G           X_MM     &kp M         &hmr RSHFT N  &hmr RGUI E   &hmr RALT I   &hmr RCTRL O    X_RM
// //├──────┤ ├─────────────┼─────────────┼─────────────┼─────────────┼─────────────┤ ├──────┤ ├─────────────┼─────────────┼─────────────┼─────────────┼─────────────┤ ├──────┤
//     X_LB     X_LOB         &kp X         &kp C         &kp D         X_LIB           X_MB     X_RIB         &kp H         &comma_morph  &dot_morph    X_ROB           X_RB
// //├──────┤ ╰─────────────┼─────────────┴─────────────┼─────────────┼─────────────┤ ├──────┤ ├─────────────┼─────────────┼─────────────┴───────────────────────────╯ ├──────┤
//     X_LH                                               &lt_spc NAV 0 &lt FN RET      X_MH     SMART_NUM     &smart_shft                                               X_RH
// //╰──────╯                                           ╰─────────────┴─────────────╯ ╰──────╯ ╰─────────────┴─────────────╯                                           ╰──────╯
// )

// ZMK_LAYER(nav,
// //╭──────╮ ╭─────────────┬─────────────┬─────────────┬─────────────┬─────────────╮ ╭──────╮ ╭─────────────┬─────────────┬─────────────┬─────────────┬─────────────╮ ╭──────╮
//     X_LT     &kp ESC       ___           &kp LS(TAB)   &swapper      ___             X_MT     &kp PG_UP     NAV_BSPC      NAV_UP        NAV_DEL       ___             X_RT
// //├──────┤ ├─────────────┼─────────────┼─────────────┼─────────────┼─────────────┤ ├──────┤ ├─────────────┼─────────────┼─────────────┼─────────────┼─────────────┤ ├──────┤
//     X_LM     &sk LCTRL     &sk LALT      &sk LGUI      &sk LSHFT     ___             X_MM     &kp PG_DN     NAV_LEFT      NAV_DOWN      NAV_RIGHT     ___             X_RM
// //├──────┤ ├─────────────┼─────────────┼─────────────┼─────────────┼─────────────┤ ├──────┤ ├─────────────┼─────────────┼─────────────┼─────────────┼─────────────┤ ├──────┤
//     X_LB                   ___           ___           ___                           X_MB                   &kp TAB       ___           &kp RET                       X_RB
// //├──────┤ ╰─────────────┼─────────────┴─────────────┼─────────────┼─────────────┤ ├──────┤ ├─────────────┼─────────────┼─────────────┴───────────────────────────╯ ├──────┤
//     X_LH                                               ___           ___             X_MH     ___           CANCEL                                                    X_RH
// //╰──────╯                                           ╰─────────────┴─────────────╯ ╰──────╯ ╰─────────────┴─────────────╯                                           ╰──────╯
// )

// ZMK_LAYER(fn,
// //╭──────╮ ╭─────────────┬─────────────┬─────────────┬─────────────┬─────────────╮ ╭──────╮ ╭─────────────┬─────────────┬─────────────┬─────────────┬─────────────╮ ╭──────╮
//     X_LT     &kp F12       &kp F7        &kp F8        &kp F9        ___             X_MT     ___           &kp C_PREV    &kp C_VOL_UP  &kp C_NEXT    &win_sleep      X_RT
// //├──────┤ ├─────────────┼─────────────┼─────────────┼─────────────┼─────────────┤ ├──────┤ ├─────────────┼─────────────┼─────────────┼─────────────┼─────────────┤ ├──────┤
//     X_LM     &hml LGUI F11 &hml LALT F4  &hml LSHFT F5 &hml LCTRL F6 ___             X_MM     ___           DSK_PREV      VOL_DOWN      DSK_NEXT      ___             X_RM
// //├──────┤ ├─────────────┼─────────────┼─────────────┼─────────────┼─────────────┤ ├──────┤ ├─────────────┼─────────────┼─────────────┼─────────────┼─────────────┤ ├──────┤
//     X_LB     &kp F10       &kp F1        &kp F2        &kp F3        ___             X_MB     PIN_APP       PIN_WIN       DSK_MGR       ___           ___             X_RB
// //├──────┤ ╰─────────────┼─────────────┴─────────────┼─────────────┼─────────────┤ ├──────┤ ├─────────────┼─────────────┼─────────────┴───────────────────────────╯ ├──────┤
//     X_LH                                               ___           ___             X_MH     &kp C_MUTE    &kp C_PP                                                  X_RH
// //╰──────╯                                           ╰─────────────┴─────────────╯ ╰──────╯ ╰─────────────┴─────────────╯                                           ╰──────╯
// )

// ZMK_LAYER(num,
// //╭──────╮ ╭─────────────┬─────────────┬─────────────┬─────────────┬─────────────╮ ╭──────╮ ╭─────────────┬─────────────┬─────────────┬─────────────┬─────────────╮ ╭──────╮
//     X_LT     ___           &kp N7        &kp N8        &kp N9        ___             X_MT     ___           ___           ___           ___           ___             X_RT
// //├──────┤ ├─────────────┼─────────────┼─────────────┼─────────────┼─────────────┤ ├──────┤ ├─────────────┼─────────────┼─────────────┼─────────────┼─────────────┤ ├──────┤
//     X_LM     &hml LGUI N0  &hml LALT N4  &hml LSHFT N5 &hml LCTRL N6 ___             X_MM     ___           ___           ___           ___           ___             X_RM
// //├──────┤ ├─────────────┼─────────────┼─────────────┼─────────────┼─────────────┤ ├──────┤ ├─────────────┼─────────────┼─────────────┼─────────────┼─────────────┤ ├──────┤
//     X_LB     ___           &kp N1        &kp N2        &kp N3        ___             X_MB     ___           ___           ___           ___           ___             X_RB
// //├──────┤ ╰─────────────┼─────────────┴─────────────┼─────────────┼─────────────┤ ├──────┤ ├─────────────┼─────────────┼─────────────┴───────────────────────────╯ ├──────┤
//     X_LH                                               ___           ___             X_MH     ___           ___                                                       X_RH
// //╰──────╯                                           ╰─────────────┴─────────────╯ ╰──────╯ ╰─────────────┴─────────────╯                                           ╰──────╯
// )

// ZMK_LAYER(sys,
// //╭──────╮ ╭─────────────┬─────────────┬─────────────┬─────────────┬─────────────╮ ╭──────╮ ╭─────────────┬─────────────┬─────────────┬─────────────┬─────────────╮ ╭──────╮
//     X_LT                                _BT_SEL_KEYS_                                X_MT     ___           ___           ___           ___           ___             X_RT
// //├──────┤ ├─────────────┼─────────────┼─────────────┼─────────────┼─────────────┤ ├──────┤ ├─────────────┼─────────────┼─────────────┼─────────────┼─────────────┤ ├──────┤
//     X_LM     ___           ___           ___           ___           &bootloader     X_MM     &bootloader   ___           ___           ___           ___             X_RM
// //├──────┤ ├─────────────┼─────────────┼─────────────┼─────────────┼─────────────┤ ├──────┤ ├─────────────┼─────────────┼─────────────┼─────────────┼─────────────┤ ├──────┤
//     X_LB     ___           ___           ___           ___           &sys_reset      X_MB     &sys_reset    ___           ___           ___           ___             X_RB
// //├──────┤ ╰─────────────┼─────────────┴─────────────┼─────────────┼─────────────┤ ├──────┤ ├─────────────┼─────────────┼─────────────┴───────────────────────────╯ ├──────┤
//     X_LH                                               ___           ___             X_MH     ___           ___                                                       X_RH
// //╰──────╯                                           ╰─────────────┴─────────────╯ ╰──────╯ ╰─────────────┴─────────────╯                                           ╰──────╯
// )

// ZMK_LAYER(mouse,
// //╭──────╮ ╭─────────────┬─────────────┬─────────────┬─────────────┬─────────────╮ ╭──────╮ ╭─────────────┬─────────────┬─────────────┬─────────────┬─────────────╮ ╭──────╮
//     X_LT     ___           ___           ___           ___           ___             X_MT     U_WH_L        U_WH_D        U_MS_U         U_WH_U       U_WH_R          X_RT
// //├──────┤ ├─────────────┼─────────────┼─────────────┼─────────────┼─────────────┤ ├──────┤ ├─────────────┼─────────────┼─────────────┼─────────────┼─────────────┤ ├──────┤
//     X_LM     ___           ___           ___           ___           ___             X_MM     ___           U_MS_L        U_MS_D         U_MS_R       ___             X_RM
// //├──────┤ ├─────────────┼─────────────┼─────────────┼─────────────┼─────────────┤ ├──────┤ ├─────────────┼─────────────┼─────────────┼─────────────┼─────────────┤ ├──────┤
//     X_LB     ___           ___           ___           ___           ___             X_MB     ___           &mkp MB4      &mkp MCLK      &mkp MB5     ___             X_RB
// //├──────┤ ╰─────────────┼─────────────┴─────────────┼─────────────┼─────────────┤ ├──────┤ ├─────────────┼─────────────┼─────────────┴───────────────────────────╯ ├──────┤
//     X_LH                                               ___           ___             X_MH     &mkp LCLK     &mkp RCLK                                                 X_RH
// //╰──────╯                                           ╰─────────────┴─────────────╯ ╰──────╯ ╰─────────────┴─────────────╯                                           ╰──────╯
// )

/* vim: set ft=c tw=174: */
